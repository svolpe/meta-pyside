## conf/layer.conf
```bitbake
# We have a conf and classes directory, add to BBPATH
BBPATH := "${BBPATH}:${LAYERDIR}"

# We have a packages directory, add to BBFILES
BBFILES := "${BBFILES} ${LAYERDIR}/recipes-*/*/*.bb \
            ${LAYERDIR}/recipes-*/*/*.bbappend \
            ${BBFILES} ${LAYERDIR}/meta-*/*/*.bb \
            ${LAYERDIR}/meta-*/*/*.bbappend"

BBFILE_COLLECTIONS += "meta-pyside"
BBFILE_PATTERN_meta-pyside := "^${LAYERDIR}/"
BBFILE_PRIORITY_meta-pyside = "10"
```
